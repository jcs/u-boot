## configs/pomera-dm250us_defconfig
```kconfig
#include <configs/pomera-dm250_defconfig>
CONFIG_DEFAULT_DEVICE_TREE="rockchip/pomera-dm250us"
CONFIG_DEFAULT_FDT_FILE="rockchip/pomera-dm250us.dtb"
```
